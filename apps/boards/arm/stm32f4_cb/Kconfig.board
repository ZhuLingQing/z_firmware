## apps/boards/arm/stm32f4_cb/Kconfig.board
```kconfig
# STM32F411CEU6 Core board configuration

# Copyright (c) 2024 Thomas.Zhu
# SPDX-License-Identifier: Apache-2.0

config BOARD_STM32F4_CB
	bool "STM32F411CEUb Core board"
	depends on SOC_STM32F411XX
```

## apps/boards/arm/stm32f4_cb/Kconfig.defconfig
```kconfig
# STM32F411CEU6 Core board configuration

# Copyright (c) 2024 Thomas.Zhu
# SPDX-License-Identifier: Apache-2.0

if BOARD_STM32F4_CB

config BOARD
	default "stm32f4_cb"

endif # BOARD_STM32F4_CB
```

## apps/boards/arm/stm32f4_cb/stm32f4_cb_defconfig
```kconfig
# SPDX-License-Identifier: Apache-2.0

CONFIG_SOC_SERIES_STM32F4X=y
CONFIG_SOC_STM32F411XE=y
CONFIG_PROD_STM32F4_CB=y

# enable uart driver
CONFIG_SERIAL=y
# enable console
CONFIG_CONSOLE=y
CONFIG_UART_CONSOLE=y

# enable GPIO
CONFIG_GPIO=y

# enable clocks
CONFIG_CLOCK_CONTROL=y

# enable pin controller
CONFIG_PINCTRL=y

# # Enable MPU
# CONFIG_ARM_MPU=n

# # Enable HW stack protection
# CONFIG_HW_STACK_PROTECTION=n

# # Enable clocks
# CONFIG_CLOCK_CONTROL=y

# # enable pin controller
# CONFIG_PINCTRL=y

# # Enable UART
# CONFIG_SERIAL=y
# CONFIG_UART_INTERRUPT_DRIVEN=y

# # Console
# CONFIG_CONSOLE=y
# CONFIG_UART_CONSOLE=y

# # Enable GPIO
# CONFIG_GPIO=y
# CONFIG_GPIO_GET_CONFIG=y

# # I2C Controller
# CONFIG_I2C=n

# # SPI Controller
# CONFIG_SPI=n

# # Flash Drivers
# CONFIG_FLASH=y
# CONFIG_FLASH_MAP=n # y

# # Ethernet hardware checksum
# CONFIG_ETH_STM32_HW_CHECKSUM=n

# # Network misc
# CONFIG_POSIX_API=y

# # Misc
# CONFIG_SYS_CLOCK_TICKS_PER_SEC=100000
# CONFIG_GENERAL_TASK_STACK_SIZE=4096
# CONFIG_MINIMAL_LIBC=y
# CONFIG_COMMON_LIBC_MALLOC_ARENA_SIZE=327680

# CONFIG_REBOOT=y

# CONFIG_PROD_STM32F4_CB=y
```

## apps/boards/arm/tzhu_32c031c6/Kconfig.board
```kconfig
# Copyright (c) 2022 Thomas.Zhu
# SPDX-License-Identifier: Apache-2.0

config BOARD_TZHU_32C031C6
	bool "TZHU_32C031C6 Board"
	depends on SOC_STM32C031XX
```

## apps/boards/arm/tzhu_32c031c6/Kconfig.defconfig
```kconfig
# STM32C031C6 Mini board configuration

# Copyright (c) 2024 Thomas.Zhu
# SPDX-License-Identifier: Apache-2.0

if BOARD_TZHU_32C031C6

config BOARD
	default "tzhu_32c031c6"

endif # BOARD_TZHU_32C031C6
```

## apps/boards/arm/tzhu_32c031c6/tzhu_32c031c6_defconfig
```kconfig
# SPDX-License-Identifier: Apache-2.0

CONFIG_SOC_SERIES_STM32C0X=y
CONFIG_SOC_STM32C031XX=y
CONFIG_PROD_TZHU_32C031C6=y

# enable uart driver
CONFIG_SERIAL=y
# enable console
CONFIG_CONSOLE=y
CONFIG_UART_CONSOLE=y

# enable GPIO
CONFIG_GPIO=y

# enable clocks
CONFIG_CLOCK_CONTROL=y

# enable pin controller
CONFIG_PINCTRL=y
```

## apps/boards/arm/yehuo_103ze/Kconfig.board
```kconfig
# STM32F103RCT6 Mini board configuration

# Copyright (c) 2020 WuhanStudio
# SPDX-License-Identifier: Apache-2.0

config BOARD_YEHUO_103ZE
	bool "Yehuo_103ze Board"
	depends on SOC_STM32F103XE
```

## manifest-repo/west.yml
```yaml
manifest:
  self:
    path: manifest-repo

  remotes:
    - name: upstream
      url-base: https://jihulab.com/qiaowen

  projects:
    - name: zoysia
      remote: upstream
      revision: master
      import: true
```
